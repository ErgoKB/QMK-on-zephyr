## src/split/Kconfig
```kconfig
config QMK_ON_ZEPHYR_SPLIT_BLE
    bool "QMK on zephyr split ble support"
    select BT
    select BT_SMP
    select BT_SMP_SC_PAIR_ONLY
    select BT_SMP_APP_PAIRING_ACCEPT
    select BT_SETTINGS
    select SETTINGS
    select BT_CENTRAL
    select BT_GATT_CLIENT
    select BT_GATT_AUTO_DISCOVER_CCC
    select BT_USER_PHY_UPDATE
    select BT_AUTO_PHY_UPDATE

rsource "bluetooth/Kconfig"
```

## src/split/bluetooth/Kconfig
```kconfig
if QMK_ON_ZEPHYR_SPLIT_BLE

config BLE_INIT_PRIORITY
    int "BLE init priority"
    default 50

config ZMK_BLE_SPLIT_CENTRAL_SPLIT_RUN_STACK_SIZE
    int "BLE split central write thread stack size"
    default 512

config ZMK_BLE_THREAD_PRIORITY
    int "BLE notify thread priority"
    default 5

config ZMK_BLE_SPLIT_PERIPHERAL_COUNT
    int "Number of split to connect to"

endif
```
